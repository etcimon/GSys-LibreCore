// SPDX-License-Identifier: MIT
// Copyright (c) 2026 Etienne Cimon
//
// Opt-in G6LC_APU OpenSBI domain on the dual-core NrHarts=1 stream8 tree.
// Not a default DTB. Do not apply to ariane-smt2.dts (NrHarts=2).
// Does not patch build-opensbi-smt2.sh. Not an OpenSBI firmware boot of
// the full testharness.

/include/ "ariane-stream8.dts"
/include/ "g6lc-apu-domain.dtsi"

&apu_firmware {
  possible-harts = <&CPU1>;
  boot-hart = <&CPU1>;
};

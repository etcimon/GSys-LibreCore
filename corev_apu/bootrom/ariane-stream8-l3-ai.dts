// GENERATED by build-platform ai-overlay pin -- do not edit.
// g6lc64_stream8_l3_ai: ariane-stream8-l3.dts plus the Xg6lcai matrix plane (g6lc-ai-matrix.dtsi)
// and the xg6lcai ISA token on every cpu. Regenerate with
// bun run src/cli/index.ts ai-overlay pin --target g6lc64_stream8_l3
/dts-v1/;

/include/ "ariane-stream8-l3.dts"
/include/ "g6lc-ai-matrix.dtsi"

&CPU0 {
  riscv,isa-extensions = "i", "m", "a", "f", "d", "c", "b", "zicntr", "zicsr", "zifencei", "zihpm", "zba", "zbb", "zbs", "zcb", "zicond", "zicbom", "zicboz", "zicbop", "zacas", "zkn", "sstc", "sscofpmf", "zihintpause", "svpbmt", "zawrs", "xg6lcai";
};

&CPU1 {
  riscv,isa-extensions = "i", "m", "a", "f", "d", "c", "b", "zicntr", "zicsr", "zifencei", "zihpm", "zba", "zbb", "zbs", "zcb", "zicond", "zicbom", "zicboz", "zicbop", "zacas", "zkn", "sstc", "sscofpmf", "zihintpause", "svpbmt", "zawrs", "xg6lcai";
};

// Island geometry published to the driver (must track the CAP words of
// g6lc_ai_island_cfg_pkg::AiIslandLatencyDefault).
&ai_matrix {
  g6lc,acc-tile-m = <1024>;
  g6lc,acc-tile-n = <512>;
  g6lc,acc-tile-k = <512>;
  g6lc,macs-per-cycle = <512>;
  g6lc,queues = <2>;
  g6lc,queue-depth = <64>;
  g6lc,noc-width = <64>;
  g6lc,dram-gbps = <16>;
  g6lc,clusters = <1>;
};
